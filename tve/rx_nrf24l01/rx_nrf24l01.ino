/** Arduino C/C++ ***************************************** rx_nrf24l01.ino ***
 *
 * ПРИЕМНИК - примерный эскиз для радиостанций nRF24L01+,
 * как передавать данные с одного узла на другой с обработкой сбоев.
 * 
 * v2.0.2, 14.05.2026                                 Автор:      Труфанов В.Е.
 * Copyright © 2026 tve                               Дата создания: 12.05.2026

  Радиоприемники nrf24l01+ являются достаточно надежными устройствами, но на макетных платах и т.д. с несогласованной проводкой сбои могут
  возникать случайным образом по прошествии многих часов, дней или недель. На этом примере показано, как справляться с различными сбоями и
  поддерживать радиоприемник в рабочем состоянии.

  К трем основным режимам неисправности радиоприемника относятся:
  Запись на радио: Радио не отвечает - исправлено путем добавления таймаута к внутренним функциям записи в RF24 (обработка сбоев)
  Чтение с радио: Доступно всегда возвращает значение true - Исправлено путем добавления таймаута к доступным функциям пользователем. Это реализовано внутри сети RF24Network.
  Потеряны настройки конфигурации радиостанции - исправлено путем отслеживания значения, отличающегося от значения по умолчанию, и повторной настройки радиостанции, если это значение возвращается к значению по умолчанию.

 * Arduino UNO
 * -----------
 * Скетч использует 7836 байт (24%) памяти устройства. Всего доступно 32256 байт.
 * Глобальные переменные используют 368 байт (17%) динамической памяти, оставляя 1680 байт для локальных переменных. Максимум: 2048 байт.
 * "C:\Users\Евгеньевич\AppData\Local\Arduino15\packages\arduino\tools\avrdude\8.0.0-arduino1/bin/avrdude" "-CC:\Users\Евгеньевич\AppData\Local\Arduino15\packages\arduino\tools\avrdude\8.0.0-arduino1/etc/avrdude.conf" -v -V -patmega328p -carduino "-PCOM15" -b115200 -D "-Uflash:w:C:\Users\Евгеньевич\AppData\Local\arduino\sketches\FFB62B8ACB700253A43AF9BFDD89E6A5/rx_nrf24l01.ino.hex:i"
 * Avrdude version 8.0-arduino.1
 * 
 * v2.0.2, 14.05.2026:   7836 (24%) =>  368 (17%) => 1680 [2048]
 * v3.0.8, 06.04.2026:  25928 (80%) => 1415       => 633
 *
**/

#include <SPI.h>
#include "RF24.h"
#include "printf.h"

/*
Arduino UNO                        NRF24L01
-----------------------------------------------
13 [SCK]               ==>         [SCK]
12 [MISO]              ==>         [MISO]
11 [MOSI]              ==>         [MOSI]
7  [CE_PIN]            ==>         [CSN]
6  [CSN_PIN]           ==>         [CE]
*/

// Определяем переменные контакты контроллера для подключения к радиомодулю
#define CE_PIN 6   // номер контакта контроллера для подключения к пину CE радиомодуля
#define CSN_PIN 7  // номер контакта контроллера для подключения к пину CSN радиомодуля

// Назначаем радиомодуль на приём
bool radioNumber = 0;   // false для 1 контроллера (приемника)
// Подключаем локальные рабочие функции радиомодуля
#include "nRF24L01_tve.h"

void setup() 
{
  Serial.begin(115200);
  Serial.println(F("\nnRF24L01: стартовал прием!"));
  printf_begin();
  configureRadio();
}

void loop() 
{
  // Перезапускаем сеанс связи при обнаружении сбоя, проблемы с оборудованием  
  radio_failure_restarting();
  // Перепроверяем конфигурацию радиомодуля  
  verify_configuration_radio(); 

  char myData[32];   // зарезервировали буфер приёма пакета char[31]+'\0'
  char ackData[32];  // зарезервировали буфер для пакета подтверждения приёма (до 32 байт включительно).

  if (radio.available()) 
  {
    uint32_t failTimer = millis();

    while (radio.available())  
    {
      if (millis() - failTimer > 500) 
      {
        Serial.println("Обнаружена задержка радиосвязи");
        radio.failureDetected = true;
        break;
      }
      // Очищаем буфер и принимаем пакет
      memset(myData,'\0',32);
      radio.read(&myData, sizeof(myData));  
      Serial.print(F("Приём: ")); Serial.println(myData);
    }
    radio.stopListening();    // отключили прослушивание для обратной передачи
    // Очищаем буфер подтверждения приема и перекидываем пакет
    memset(ackData,'\0',32);
    strcat(ackData,myData); 
    // Отправляем последнее сообщение обратно
    radio.write(&ackData, sizeof(ackData));  
    radio.startListening();  // возобновляем прослушивание для приема следующих пакетов
    Serial.print(F("Ответ: ")); Serial.println(ackData);
  }
} 

// Arduino C/C++ ****************************************** rx_nrf24l01.ino ***

