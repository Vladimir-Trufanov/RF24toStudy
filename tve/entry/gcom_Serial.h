/** Arduino C/C++ ******************************************* gcom_Serial.h ***
 *
 * Принять команду из последовательного порта и выполнить контрольное действие 
 * проверки работоспособности nRF24L01+ 
 *                 
 * v1.0.3, 11.05.2026                                 Автор:      Труфанов В.Е.
 * Copyright © 2026 tve                               Дата создания: 08.05.2026
 *
 * Функция gcSerial() запускается первой в фоновом (loop) цикле приложения и имеет 
 * двойное назначение: ожидает команду из поледовательного порта и выполняет её, а,
 * при необходимости, замыкает фоновый цикл на себя, отключая его от выполнения.
 *
 * Функция возвращает -1, если команда выполнена и можно продолжить фоновый цикл.
 * Функция возвращает номер команды, если выполнение контрольного действия не завершено и
 * требуется его продолжение в цикле loop. 
 *
 * Список команд:
 * 0 - завершить заданное контрольное действие 
 * 1 - проверить работоспособности модуля nRF24L01+ и правильность его подключения 
 * 2 - просканировать каналы и обнаружить шум (помехи)
 * 3 - проверить прием данных между NRF24L01 и NRF24L01+PA+LNA

 *
**/

#ifndef GCOMSERIAL
#define GCOMSERIAL
#pragma once  

#include "mcom_nrf24l01.h"  // выполнение команд модулем nRF24L01+

// Принять команду из последовательного порта и выполнить контрольное действие 
int gcSerial();
// Убедиться, что прежнее контрольное действие завершено
bool testcom();

int ccom='x';  // полученная команда из последовательного порта
int ncom=-1;   // номер команды и результат работы функции

// ****************************************************************************
// *          Принять команду из последовательного порта и выполнить          *
// *        контрольное действие проверки работоспособности nRF24L01+         *   
// ****************************************************************************
int gcSerial()
{
  // Выполняем первую проверку: 
  // если поступила команда из последовательного порта, то отрабатываем её
  if (Serial.available())
  {
    ccom = Serial.read();
    //Serial.print("Команда '"); Serial.println(ncom); 
    // Выполняем команду по завершению заданного контрольного действия 
    if (ccom == '0') ncom=-1;
    // Выполняем команду проверки работоспособности модуля nRF24L01+ 
    // и правильность его подключения   
    else if (ccom == '1') 
    {
      Check_nRF24L01();
      ncom=-1;
    }
    // Готовим сканирование каналов и обнаружение шума (помех)
    else if (ccom == '2') 
    {
      if (testcom())
      {
        ScanChannelStart(); ncom=2;
      }
    }
    // Готовим проверку приема данных между NRF24L01 и NRF24L01+PA+LNA
    else if (ccom == '3') 
    {
      if (testcom())
      {
        ReceptStart_nRF24L01(); ncom=3;
      }
    }
  }

  // Выполняем вторую проверку: 
  // если следует продолжать действие из нескольких циклов, то делаем это
  if (ncom>0)
  {
    // Cканируем каналы и обнаруживаем шум (помехи)
    if (ncom==2) 
    {
      ScanChannelNext();
      // Serial.println("ncom=2"); 
      delay(1000);
    }
    // Выполняем проверку приема данных между NRF24L01 и NRF24L01+PA+LNA
    else if (ncom==3) 
    {
      ReceptNext_nRF24L01();
    }
  }
  return ncom;
} 
// ****************************************************************************
// *          Убедиться, что прежнее контрольное действие завершено           *
// ****************************************************************************
bool testcom()
{
  if (ncom>0)
  {
    Serial.print("Циклы контрольного действия по прежней команде '"); 
    Serial.print(ncom); 
    Serial.println("' еще не завершены!"); 
    return false;
  }
  else return true;
}

#endif 

// ********************************************************** gcom_Serial.h ***
                                                                                                                                                                                                  
