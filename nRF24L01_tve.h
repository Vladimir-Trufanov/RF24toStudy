/** Arduino ************************************************ nRF24L01_tve.h ***
 * 
 *           Локальные рабочие функции радиомодуля nRF24L01 для приемо-передачи
 * 
 * v2.0.2, 14.05.2026                                 Автор:      Труфанов В.Е.
 * Copyright © 2026 tve                               Дата создания: 12.05.2026
**/

#ifndef nRF24L01_tve_h
#define nRF24L01_tve_h
#pragma once  

// Объявляем объект радиомодуля (CE_PIN, CSN_PIN - определены в основном коде                                                                )
RF24 radio(CE_PIN, CSN_PIN);
byte addresses[][6] = {"1Node","2Node"};

#define tmeVerifyConfig 5000  // интервал между проверками конфигурации радиомодуля (мсек)

// Настроить приемо-передачу радиомодулей nRF24L01 для RF24 radio(CE_PIN, CSN_PIN)
void configureRadio(); 
// Перезапустить сеанс связи при обнаружении сбоя, проблемы с оборудованием  
void radio_failure_restarting();
// Перепроверить конфигурацию радиомодуля  
void verify_configuration_radio(uint32_t intConfig=tmeVerifyConfig); 

// ****************************************************************************
// *             Настроить приемо-передачу радиомодулей nRF24L01              *
// *                    для RF24 radio(CE_PIN, CSN_PIN);                      *
// ****************************************************************************
void configureRadio() 
{
  radio.begin();
  // Устанавливаем низкий уровень мощности (PA — Power Amplifier), чтобы предотвратить проблемы, 
  // связанные с питанием, поскольку устройства расположены близко. Значение по умолчанию - RF24_PA_MAX.
  // Константы, соответствующие разным уровням мощности в дБм: RF24_PA_MIN — −18 дБм; RF24_PA_LOW — −12 дБм; 
  // RF24_PA_HIGH — -6 дБм; RF24_PA_MAX — 0 дБм (максимальная мощность).
  radio.setPALevel(RF24_PA_MIN);
  // По умолчанию модуль NRF24L01 работает на передающем канале 76h. 
  // Частотный диапазон модуля NRF24L01 разбит на 128 каналов с шагом 1 МГц: от 2,4 ГГц до 2,527 ГГц. 
  // Например, каналу 0 соответствует частота 2,4 ГГц, а каналу 37 — частота 2,437 ГГц. 
  radio.setChannel(0x6F); // установили канал

  // Открываем каналы записи и чтения на каждом радиоприемнике с противоположными адресами
  if (radioNumber) 
  {
    radio.openWritingPipe(addresses[1]);
    radio.openReadingPipe(1, addresses[0]);
  } 
  else 
  {
    radio.openWritingPipe(addresses[0]);
    radio.openReadingPipe(1, addresses[1]);
  }
  // Начинаем прослушивание канала и выводим начальные настройки радио модуля
  radio.startListening();
  radio.printDetails();
}
// ****************************************************************************
// * Перезапустить сеанс связи при обнаружении сбоя, проблемы с оборудованием *  
// ****************************************************************************
void radio_failure_restarting()
{
  // Обрабатываем обнаруженный сбой (проблему с оборудованием)
  if (radio.failureDetected) 
  {
    radio.failureDetected = false;
    delay(250);
    Serial.println("Сбой радиосвязи, перезапускаем сеанс");
    configureRadio();
  }
} 
// ****************************************************************************
// *                     Перепроверить конфигурацию радиомодуля               *  
// ****************************************************************************
uint32_t configTimer = millis();
void verify_configuration_radio(uint32_t intConfig=tmeVerifyConfig) 
{
  // Через заданный интервал в миллисекундах проверяем конфигурацию радиомодуля,
  // проверяя настройки, отличные от установленных по умолчанию
  if (millis() - configTimer > intConfig) 
  {
    configTimer = millis();
    if (radio.getDataRate() != RF24_1MBPS) 
    {
      radio.failureDetected = true;
      Serial.println("Ошибка конфигурации радиомодуля!");
    }
  }
}



#endif

// ********************************************************* nRF24L01_tve.h ***

